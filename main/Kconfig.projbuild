## main/Kconfig.projbuild
```kconfig
# SPDX-License-Identifier: Apache-2.0
menu "WiFi Bridge"

    config WB_DEFAULT_BOARD
        string "Default Ethernet board (changeable at runtime)"
        default "wt32-eth01"
        help
            One of: wt32-eth01, olimex-poe, olimex-gateway, esp32-eth-kit, wesp32, wesp32-lan8720,
            lilygo-poe, custom. Used until a board is chosen in the web UI.

    config WB_HOSTNAME_PREFIX
        string "Hostname prefix (the last 3 MAC bytes are appended)"
        default "wifi-bridge"

    config WB_DEFAULT_LED_PIN
        int "Default status LED GPIO (-1 = none)"
        default -1

    config WB_DEFAULT_BUTTON_PIN
        int "Default button GPIO (-1 = none)"
        default -1

    menu "Preset settings (optional)"
        comment "Defaults for unattended installs; also restored by a factory reset. Leave empty for setup mode."
        config WB_PRESET_SSID
            string "Wi-Fi SSID"
            default ""
        config WB_PRESET_PASSWORD
            string "Wi-Fi password"
            default ""
        config WB_PRESET_IP
            string "Management IP address"
            default ""
        config WB_PRESET_NETMASK
            string "Management netmask"
            default "255.255.255.0"
        config WB_PRESET_GATEWAY
            string "Gateway"
            default ""
        config WB_PRESET_DNS
            string "DNS server (empty = gateway)"
            default ""
        config WB_PRESET_ADMIN_PASSWORD
            string "Web admin password"
            default ""
        config WB_PRESET_HOSTNAME
            string "Hostname (empty = prefix + MAC)"
            default ""
    endmenu

    config WB_QEMU
        bool "QEMU test build (OpenCores Ethernet, no Wi-Fi)"
        default n
        select ETH_USE_OPENETH
        help
            For automated tests in QEMU only: the wired port uses the emulated OpenCores MAC and
            Wi-Fi is not started. See tools/qemu-build.sh and tools/qemu_test.py.

endmenu
```

## safeboot/sdkconfig.defaults
```kconfig
# SPDX-License-Identifier: Apache-2.0
# Safeboot firmware: has to fit the 768 KB factory partition
CONFIG_IDF_TARGET="esp32"
CONFIG_ESPTOOLPY_FLASHSIZE_4MB=y
CONFIG_PARTITION_TABLE_CUSTOM=y
CONFIG_PARTITION_TABLE_CUSTOM_FILENAME="partitions.csv"
CONFIG_COMPILER_OPTIMIZATION_SIZE=y
CONFIG_COMPILER_OPTIMIZATION_ASSERTIONS_SILENT=y
CONFIG_BOOTLOADER_APP_ROLLBACK_ENABLE=y

# https downloads
CONFIG_MBEDTLS_CERTIFICATE_BUNDLE=y
CONFIG_MBEDTLS_CERTIFICATE_BUNDLE_DEFAULT_CMN=y

CONFIG_ESP_SYSTEM_PANIC_PRINT_REBOOT=y
CONFIG_ESP_COREDUMP_ENABLE_TO_NONE=y
CONFIG_ESP_TASK_WDT_TIMEOUT_S=10

# Logs on UART0 (TX0/RX0), 115200
CONFIG_ESP_CONSOLE_UART_DEFAULT=y
CONFIG_ESP_CONSOLE_UART_BAUDRATE=115200
CONFIG_LOG_COLORS=n
# warnings and errors only: saves the SDK's info strings (our own messages use printf/LOGW)
CONFIG_LOG_DEFAULT_LEVEL_WARN=y
CONFIG_LOG_MAXIMUM_LEVEL_WARN=y

CONFIG_ESP_WIFI_ENABLE_WPA3_SAE=y
CONFIG_ESP_WIFI_NVS_ENABLED=n
CONFIG_ESP_PHY_CALIBRATION_AND_DATA_STORAGE=n
CONFIG_ESP_WIFI_AMPDU_TX_ENABLED=n

CONFIG_ETH_ENABLED=y
CONFIG_ETH_USE_ESP32_EMAC=y

CONFIG_LWIP_IPV6=n
CONFIG_LWIP_MAX_SOCKETS=12
CONFIG_LWIP_TCP_SND_BUF_DEFAULT=11520
CONFIG_LWIP_TCP_WND_DEFAULT=11520
CONFIG_LWIP_TCP_RECVMBOX_SIZE=16

CONFIG_HTTPD_MAX_REQ_HDR_LEN=1024
CONFIG_HTTPD_MAX_URI_LEN=512
CONFIG_HTTPD_PURGE_BUF_LEN=128
CONFIG_ESP_MAIN_TASK_STACK_SIZE=6144
CONFIG_ESP_TIMER_TASK_STACK_SIZE=4096
CONFIG_NEWLIB_NANO_FORMAT=y
# size: TLS client only (https downloads); small printf (all JSON numbers are integers)
CONFIG_MBEDTLS_TLS_CLIENT_ONLY=y
CONFIG_MBEDTLS_SSL_RENEGOTIATION=n
CONFIG_MBEDTLS_SSL_ALPN=n
CONFIG_MBEDTLS_SSL_PROTO_DTLS=n
CONFIG_MBEDTLS_ECP_DP_SECP192R1_ENABLED=n
CONFIG_MBEDTLS_ECP_DP_SECP224R1_ENABLED=n
CONFIG_MBEDTLS_ECP_DP_SECP521R1_ENABLED=n
CONFIG_MBEDTLS_ECP_DP_SECP192K1_ENABLED=n
CONFIG_MBEDTLS_ECP_DP_SECP224K1_ENABLED=n
CONFIG_MBEDTLS_ECP_DP_SECP256K1_ENABLED=n
CONFIG_MBEDTLS_ECP_DP_BP256R1_ENABLED=n
CONFIG_MBEDTLS_ECP_DP_BP384R1_ENABLED=n
CONFIG_MBEDTLS_ECP_DP_BP512R1_ENABLED=n
CONFIG_MBEDTLS_ECP_NIST_OPTIM=n
CONFIG_MBEDTLS_CCM_C=n
CONFIG_MBEDTLS_PEM_WRITE_C=n
CONFIG_MBEDTLS_X509_CSR_PARSE_C=n
CONFIG_MBEDTLS_X509_CRL_PARSE_C=n
CONFIG_MBEDTLS_ECJPAKE_C=n
# Wi-Fi: no enterprise (802.1X) or OWE in the safeboot firmware
CONFIG_ESP_WIFI_ENTERPRISE_SUPPORT=n
CONFIG_ESP_WIFI_ENABLE_WPA3_OWE_STA=n
CONFIG_ESP_WIFI_SOFTAP_SAE_SUPPORT=n
```
